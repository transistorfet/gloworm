## Kconfig
```kconfig
# For a description of the syntax of this configuration file,
# see the linux kernel's Documentation/kbuild/kconfig-language.rst.
#
mainmenu "Gloworm Configuration"

source "src/Kconfig.arch"

source "src/Kconfig"

source "src/kernel/Kconfig"

source "src/commands/Kconfig"

source "src/boot/Kconfig"

source "src/monitor/Kconfig"
```

## src/Kconfig
```kconfig
menu "General setup"

choice
	prompt "Compiler optimization level"
	default CC_OPTIMIZE_FOR_PERFORMANCE

config CC_OPTIMIZE_FOR_PERFORMANCE
	bool "Optimize for performance (-O2)"
	help
	  This is the default optimization level for the kernel, building
	  with the "-O2" compiler flag for best performance and most
	  helpful compile-time warnings.

config CC_OPTIMIZE_FOR_PERFORMANCE_O3
	bool "Optimize more for performance (-O3)"
	help
	  Choosing this option will pass "-O3" to your compiler to optimize
	  the kernel yet more for performance.

config CC_OPTIMIZE_FOR_SIZE
	bool "Optimize for size (-Os)"
	help
	  Choosing this option will pass "-Os" to your compiler resulting
	  in a smaller kernel.

endchoice

endmenu
```

## src/Kconfig.arch
```kconfig
choice
	prompt "Architecture"

config ARCH_M68K
	bool "m68k"
	help
	  Configure the kernel to run on the Motorola 680x0 family of
	  architectures

config ARCH_TESTAPP
	bool "testapp"
	help
	  Configure the kernel to run as an application under linux for running
	  tests and such.  This is more so a place to experiment with alternate
	  configuration in opposition to the only other architecture, m68k.

endchoice

config ARCH
	string
	default "m68k" if ARCH_M68K

config ARCH
	string
	default "testapp" if ARCH_TESTAPP
```

## src/boot/Kconfig
```kconfig
menu "Bootloader setup"

config BOOT
	bool "Build the Bootloader"
	default y
	depends on ATA
	help
	  This bootloader will load the kernel from disk on /dev/ata0, expecting a
	  minix filesystem in an msdos partition table.

if BOOT

endif

endmenu
```

## src/commands/Kconfig
```kconfig
menu "Commands"

config COMMANDS
	bool "Build commands"
	default y
	help
	  Build the user commands

if COMMANDS

config CMD_SH
	bool "sh"
	default y
	help
	  The pseudo-shell, a very incomplete shell program that can launch
	  other programs.  

if CMD_SH

config SHELL_WITH_UTILS
	bool "Include the some basic /bin utilities in the shell"
	help
	  This will compile some utilities such as cat, cp, mv, ps, mount,
	  kill, date, and so on, into a single elf.  The commands that are
	  included will be run in a separate process using the same read-only
	  memory area.  Any non-built-in commands will be run as normal, by
	  attempting to load an elf executable from the file system.

endif

config TEST_CMDS
	bool "build the various test commands"
	default y
	depends on NET
	help
	  There are some basic tests that can be built, such as `hello`,
	  `daemontest`, `tcptest`, `tcpserv`, and so on

endif

endmenu
```

## src/kernel/Kconfig
```kconfig
menu "Kernel Configuration"

config KERNEL
	bool "Build the kernel"
	default y
	help
	  Build the kernel

if KERNEL

source "src/kernel/arch/Kconfig"

source "src/kernel/drivers/Kconfig"

source "src/kernel/fs/Kconfig"

source "src/kernel/mm/Kconfig"

source "src/kernel/net/Kconfig"

source "src/kernel/proc/Kconfig"

comment "Miscellaneous options"

config SHELL_IN_KERNEL
	bool "Include the `init` and `sh` code in the kernel binary"
	help
	  This will compile the init process and shell, along with some
	  utilities such as cat, cp, mv, ps, mount, kill, date, and so on, into
	  one binary blob.  The kernel will start the first process and call
	  the init function instead of trying to load the init elf file from
	  the file system.  The init process will create the first shell
	  process and the shell will launch the utilities that are built-in
	  the same way, and any non-built-in commands will be run as normal,
	  by attempting to load an elf executable from the file system.  This
	  option is handy when sending the kernel over serial, to a computer
	  running the monitor from ROM, when no secondary storage is available
	  or when it's not working correctly.

choice
	prompt "Log level"
	default LOG_LEVEL_INFO

config LOG_LEVEL_NOTICE
	bool "notice"
	help
	  This option selects the NOTICE log level as the minimum level to print.
	  Log messages that are equal to or more critical than this level will
	  be printed to the console

config LOG_LEVEL_INFO
	bool "info"
	help
	  This option selects the INFO log level as the minimum level to print.
	  Log messages that are equal to or more critical than this level will
	  be printed to the console

config LOG_LEVEL_DEBUG
	bool "debug"
	help
	  This option selects the DEBUG log level as the minimum level to print.
	  Log messages that are equal to or more critical than this level will
	  be printed to the console

config LOG_LEVEL_TRACE
	bool "trace"
	help
	  This option selects the TRACE log level as the minimum level to print.
	  Log messages that are equal to or more critical than this level will
	  be printed to the console

endchoice

endif

endmenu
```

## src/kernel/arch/Kconfig
```kconfig
menu "Architecture setup"

source "src/kernel/arch/m68k/Kconfig"

source "src/kernel/arch/testapp/Kconfig"

endmenu

config CPU_BIG_ENDIAN
	bool

config CPU_LITTLE_ENDIAN
	bool

config USER_MODE
	bool
```

## src/kernel/arch/m68k/Kconfig
```kconfig
if ARCH_M68K

config M68K
	bool
	default y
	select CPU_BIG_ENDIAN

config GCC_PREFIX
	string
	default m68k-linux-gnu-

config NUM_CPUS
	int
	default 1

choice
	prompt "Minimum required CPU"
	default MC68030

config MC68010
	bool "MC68010+"
	help
	  This selects the 68010 CPU as the lowest common architecture for
	  all software in this suite.  All files will be compiled with the
	  -m68010 flag, and the system will be assumed to use a 16-bit
	  bus, with separate even and odd bytes.  Furthermore, it will be
	  assumed that the CPU supports the VBR register for relocating the
	  interrupt vector table.

config MC68030
	bool "MC68030+"
	help
	  This option selects the 68030 as the lowest common architecture for
	  all software in this suite.  All files will be compiled with the
	  -m68030 flag.  Furthermore, it will be assumed that the CPU has an
	  MMU and cache.

endchoice

config M68K_USER_MODE
	bool "enable user mode"
	default n
	select USER_MODE
	help
	  If this option is true, then all programs except the kernel itself
	  will be run in the m68k processor's user mode, and the kernel will be
	  run in supervisor mode.  If this option is false, then everything
	  will run in supervisor mode, and the CPU will never switch to user
	  mode

config MMU
	bool "enable MMU (memory management unit)"
	default n
	depends on MC68030
	depends on M68K_USER_MODE
	help
	  If this is option true, the kernel will enable the hardware-based MMU
	  (Memory Management Unit) and run user processes in their own isolated
	  virtual memory space.  If false, only physical memory addresses will
	  be used.  It's recommended to select this option if the system it's
	  running on has a supported MMU.

choice
	prompt "Page size"
	default PAGE_SIZE_4K
	help
	  Select the size used by the MMU-based paged memory management system
	  for the size in bytes of a single page of memory, which is the
	  smallest unit of memory that can be allocated by the page allocator,
	  mapped into a virtual memory address space, or swapped out of active
	  RAM to secondary memory (eg. to a disk).  The page size is usually
	  determined by the MMU, but in the case of the m68k family, the page
	  size can be configured in powers of two from 256 bytes up to 32kB.

config PAGE_SIZE_256
	bool "256"
	help
	  This selects a virtual memory page size of 256 bytes

config PAGE_SIZE_512
	bool "512"
	help
	  This selects a virtual memory page size of 512 bytes

config PAGE_SIZE_1K
	bool "1K"
	help
	  This selects a virtual memory page size of 1024 bytes

config PAGE_SIZE_2K
	bool "2K"
	help
	  This selects a virtual memory page size of 2048 bytes

config PAGE_SIZE_4K
	bool "4K"
	help
	  This selects a virtual memory page size of 4096 bytes

config PAGE_SIZE_8K
	bool "8K"
	help
	  This selects a virtual memory page size of 8192 bytes

config PAGE_SIZE_16K
	bool "16K"
	help
	  This selects a virtual memory page size of 16384 bytes

config PAGE_SIZE_32K
	bool "32K"
	help
	  This selects a virtual memory page size of 32768 bytes

endchoice

endif
```

## src/kernel/arch/testapp/Kconfig
```kconfig
if ARCH_TESTAPP

config TESTAPP
	bool
	default y
	select CPU_LITTLE_ENDIAN

config GCC_PREFIX
	string
	default ""

endif
```

## src/kernel/drivers/Kconfig
```kconfig
menu "Device drivers"

source "src/kernel/drivers/block/Kconfig"

source "src/kernel/drivers/net/Kconfig"

source "src/kernel/drivers/tty/Kconfig"

endmenu
```

## src/kernel/drivers/block/Kconfig
```kconfig
menuconfig ATA
	bool "ATA device driver"
	default y
	help
	  This enables the ATA driver, which requires an address where the
	  ATA registers can be accessed

if ATA

config ATA_BASE
	hex "Base address of memory-mapped ATA registers"
	help
	  This is the address where the ATA registers are mapped to

endif

menuconfig MEMDISK
	bool "Memdisk support"
	default y
	help
	  This enables the Memdisk device driver, which requires a fixed size that
	  will be reserved

if MEMDISK

config MEMDISK0_START
	hex "Memdisk start address"
	depends on !MEM_LAYOUT_AUTO
	default 0x1E0000
	help
	  This is the memory start address for the first memdisk which can be used as an initial RAM fs.

config MEMDISK0_SIZE
	hex "Memdisk size"
	default 0x20000
	help
	  This is the amount of memory used for the first memdisk.

endif
```

## src/kernel/drivers/net/Kconfig
```kconfig
if NET

menu "Network Intefaces"

config SLIP
	bool "SLIP network interface"
	default y
	help
	  Include support for the SLIP (Serial Line IP) interface, which uses
	  a character device to send and receive INETV4 packets

endmenu

endif
```

## src/kernel/drivers/tty/Kconfig
```kconfig
menuconfig TTY
	bool "TTY support"
	default y
	help
	  Include the TTY subsystem

if TTY

source "src/kernel/drivers/tty/mc68681/Kconfig"

endif
```

## src/kernel/drivers/tty/mc68681/Kconfig
```kconfig
config TTY_68681
	bool "MC68681"
	default y
	help
	  This enables the driver for the Morotola MC68681 dual-serial port
	  controller

if TTY_68681

config TTY_68681_BASE
	hex "MC68681 base address"
	depends on TTY_68681
	default 0x00700001
	help
	  Base memory-mapped I/O address of the MC68681 controller.

config TTY_68681_INTVEC
	int "MC68681 Interrupt vector"
	depends on TTY_68681
	default 64
	help
	  Interrupt vector for the MC68681 controller.

config TTY_68681_CLOCKSOURCE
	bool "Use the MC68681's periodic timer as a clock source"
	depends on TTY_68681
	default y
	help
	  If this option is selected, the MC68681's timer will be set up in
	  periodic mode to generate an interrupt every 71ms.  On the interrupt,
	  the clock will be advanced and a process reschedule will be requested

config TTY_68681_GPIO_LEDS
	bool "Use the MC68681's GPIO outputs to control debug LEDs"
	depends on TTY_68681
	default y
	help
	  If this option is selected, the MC68681's general purpose output pins
	  will be set up to control LEDs, on outputs 4 through 7.  Output 7
	  will be flashed every time a context switch occurs

endif
```

## src/kernel/fs/Kconfig
```kconfig
menu "File systems"

config MSDOS_PARTITION
	bool "MSDOS Partition"
	default y
	help
	  This enables the ramdisk device, which requires a fixed size that
	  will be reserved

source "src/kernel/fs/minix/Kconfig"

source "src/kernel/fs/ext2/Kconfig"

config NAME_MAX
	int "maximum filename length"
	default 256
	help
	  The maximum number of characters in a single filename or path
	  segment.  This is used throughout the virtual file system

config PATH_MAX
	int "maximum path length"
	default 1024
	help
	  The maximum number of characters in a complete file path.  This is
	  used for buffers involving a complete path

endmenu
```

## src/kernel/fs/ext2/Kconfig
```kconfig
config EXT2_FS
	bool "Ext2 file system"
	default n
	help
	  This enables the ext2 file system support.  Only ext2 is supported at
	  this time (not ext3 or ext4).

if EXT2_FS

config EXT2_FS_MKFS
	bool "mkfs for Ext2"
	default y
	help
	  This option will include support for making new filesystems of the
	  ext2 type

endif
```

## src/kernel/fs/minix/Kconfig
```kconfig
config MINIX_FS
	bool "Minix file system"
	default y
	help
	  This enables the minix file system support.  Only v1 is supported

if MINIX_FS

config MINIX_FS_MKFS
	bool "mkfs for Minix"
	default y
	help
	  This option will include support for making new filesystems of the
	  minix type

endif
```

## src/kernel/mm/Kconfig
```kconfig
menu "Memory management"

config KERNEL_BASE
	hex "Kernel base address"
	default 0x100000
	help
	  This is the location in memory where the kernel will be loaded at.
	  This is also used when linking because the kernel is not relocatable,
	  so make sure it's set correctly.

config KERNEL_MEM_SIZE
	hex "Amount of available memory"
	default 0x100000
	help
	  This is the amount of memory available after the Kernel base address, used as the ram size in the linker
	  script. If automatic memory layout is enabled the rest of this memory block will be filled with the page memory.

config BOOT_STACK_SIZE
	hex "Kernel boot stack size"
	default 0x1000
	help
	  This is the amount of memory initially reserved for the kernel stack. Should be at least 4k (0x100).

config MEM_LAYOUT_AUTO
	bool "Automatic memory layout"
	help
	  This will make the linker calculate the addresses for the memdisk and the page memory assigning
	  the available memory as page memory.

config MEMDISK0_START
	hex "Memdisk start address"
	depends on (MEMDISK && !MEM_LAYOUT_AUTO)
	default 0x1E0000
	help
	  This is the memory start address for the first memdisk which can be used as an initial RAM fs.

config MEMDISK0_SIZE
	hex "Memdisk size"
	depends on MEMDISK
	default 0x20000
	help
	  This is the amount of memory used for the first memdisk.

if !MEM_LAYOUT_AUTO

# TODO these could move to Kconfig.machine, such that the default is set conditionally, but otherwise appears in the machine menu
config PAGES_START
	hex "Page memory start address"
	default 0x120000
	help
	  This is the start of the memory area that will be used for allocating
	  kernel memory for disk blocks, and also user program space when
	  paging is not used.  This does not include the kernel binary or
	  data/bss area, so make sure it's higher than that.

config PAGES_END
	hex "Page memory end address"
	default 0x300000
	help
	  This is the address at the top end of installed memory where the
	  kernel memory will allocate from.  Currently only one contiguous
	  chunk of memory is supported.

endif

config PAGE_SIZE
	hex
	default 256 if PAGE_SIZE_256
	default 512 if PAGE_SIZE_512
	default 1024 if PAGE_SIZE_1K
	default 2048 if PAGE_SIZE_2K
	default 4096 if PAGE_SIZE_4K
	default 8192 if PAGE_SIZE_8K
	default 16384 if PAGE_SIZE_16K
	default 32768 if PAGE_SIZE_32K
	default 65536 if PAGE_SIZE_64K

endmenu
```

## src/kernel/net/Kconfig
```kconfig
menu "Networking support"

config NET
	bool "Enable networking"
	default y
	help
	  Include the networking subsystem
if NET

config INETV4
	bool "TCP/IP v4 networking"
	default y
	help
	  Include protocol decoders for IPv4, UDPv4, TCPv4, and ICMP

source "src/kernel/drivers/net/Kconfig"

endif

endmenu
```
