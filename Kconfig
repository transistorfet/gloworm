## src/kernel/proc/Kconfig
```kconfig
menu "Process and thread options"

config USER_STACK_SIZE
	int "default user process stack size"
	default 8192
	help
	  This is size of the stack that will be allocated for each user
	  process that's executed.  It is expressed in bytes, and must be
	  aligned to CONFIG_PAGE_SIZE.

config KERNEL_STACK_SIZE
	int "default per-user-process kernel stack size in pages"
	default 2048
	help
	  This is size of the stack that will be allocated for each user
	  process that's executed, to be used exclusively by the kernel.
	  It is expressed in bytes, and must be aligned to CONFIG_PAGE_SIZE

endmenu
```

## src/monitor/Kconfig
```kconfig
menu "Monitor setup"

config MONITOR
	bool "Build the monitor"
	default y
	help
	  Build the monitor firmware that can be flashed into onboard rom.  It
	  currently only supports the computie family of 68k-based computers

if MONITOR

choice
	prompt "Board ROM configuration"
	default AM29F040

config AM29F040
	bool "Single 8-bit AM29F040"
	help
	  The monitor will be stored in one 8-bit AM29F040 flash chips.  This
	  option is used to set the programming algorithm when writing a new
	  firmware image to the board.

config DUAL_AM29F040
	bool "Two 8-bit AM29F040s, one for even bytes, and the other for odd bytes"
	help
	  The monitor will be stored in two 8-bit AM29F040 flash chips, with
	  the even bytes stored in one chip, and the odd bytes stored in the
	  other chip.  Both chips will be programmed at the same time when
	  writing a new firmware image.

endchoice

endif

endmenu
```
